## GatewayV1/build/defconfig
```kconfig
CONFIG_EXAMPLE_TX_GPIO_NUM=14
CONFIG_EXAMPLE_RX_GPIO_NUM=15
CONFIG_EXAMPLE_UART_BAUD_RATE=9600
CONFIG_BT_ENABLED=y
CONFIG_BT_CLASSIC_ENABLED=y
CONFIG_BT_SPP_ENABLED=y
# CONFIG_BT_BLE_ENABLED is not set
CONFIG_BT_ACL_CONNECTIONS=1
CONFIG_BTDM_CTRL_MODE_BR_EDR_ONLY=y
```
